&amba_pl {
	misc_clk_aie: misc_clk_aie {
		#clock-cells = <0>;
		clock-frequency = <99999000>;
		compatible = "fixed-clock";
	};
	ai_engine_0: ai_engine@20000000000 {
		clock-names = "aclk0";
		clocks = <&misc_clk_aie>;
		compatible = "xlnx,ai-engine-1.0", "xlnx,ai_engine";
		interrupt-names = "interrupt1", "interrupt2", "interrupt3";
		interrupt-parent = <&gic>;
		interrupts = <0x0 0x94 0x1>, <0x0 0x95 0x1>, <0x0 0x96 0x1>;
		power-domains = <&versal_firmware PM_DEV_AI>;
		reg = <0x00000200 0x00000000 0x00000001 0x00000000>;
	};
	aie_npi: aie-npi@f70a0000 {
		compatible = "xlnx,ai-engine-npi";
		reg = <0x0 0xf70a0000 0x0 0x1000>;
	};
};
