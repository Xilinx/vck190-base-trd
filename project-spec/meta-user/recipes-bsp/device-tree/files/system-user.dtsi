/include/ "system-conf.dtsi"
/ {
	chosen {
		stdout-path = "serial0:115200";
	};
};
&amba {
	zyxclmm_drm {
		compatible = "xlnx,zocl-versal";
		status = "okay";
	};
};
#include "pl-custom.dtsi"
#include "ina226-power-monitor.dtsi"
