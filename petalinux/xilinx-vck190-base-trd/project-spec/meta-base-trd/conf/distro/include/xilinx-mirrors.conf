## petalinux/xilinx-vck190-base-trd/project-spec/meta-base-trd/conf/distro/include/xilinx-mirrors.conf
```bitbake
# The following mirrors are only availble inside of the Xilinx network.

MIRRORS:append = "\
git://github.com/Xilinx/VVAS.git                  git://gitenterprise.xilinx.com/IPS-SSW/vvas.git \n \
git://github.com/Xilinx/Vitis-AI.git              git://gitenterprise.xilinx.com/Vitis/vitis-ai-staging.git \n \
"
```
